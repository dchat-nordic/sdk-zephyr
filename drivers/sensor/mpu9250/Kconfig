## drivers/sensor/mpu9250/Kconfig
```kconfig
# MPU9250 Nine-Axis Motion Tracking device configuration options

# Copyright (c) 2021 Nordic Semiconductor ASA
# SPDX-License-Identifier: Apache-2.0

menuconfig MPU9250
	bool "MPU9250 Nine-Axis Motion Tracking Device"
	depends on I2C
	help
	  Enable driver for MPU9250 I2C-based nine-axis motion tracking device.

if MPU9250

choice
	prompt "Trigger mode"
	default MPU9250_TRIGGER_GLOBAL_THREAD
	help
	  Specify the type of triggering to be used by the driver.

config MPU9250_TRIGGER_NONE
	bool "No trigger"

config MPU9250_TRIGGER_GLOBAL_THREAD
	bool "Use global thread"
	depends on GPIO
	select MPU9250_TRIGGER

config MPU9250_TRIGGER_OWN_THREAD
	bool "Use own thread"
	depends on GPIO
	select MPU9250_TRIGGER

endchoice

config MPU9250_TRIGGER
	bool

config MPU9250_THREAD_PRIORITY
	int "Thread priority"
	depends on MPU9250_TRIGGER_OWN_THREAD
	default 10
	help
	  Priority of thread used by the driver to handle interrupts.

config MPU9250_THREAD_STACK_SIZE
	int "Thread stack size"
	depends on MPU9250_TRIGGER_OWN_THREAD
	default 1024
	help
	  Stack size of thread used by the driver to handle interrupts.

config MPU9250_ACCEL_FS
	int "Accelerometer full-scale range"
	default 2
	help
	  Magnetometer full-scale range.
	  An X value for the config represents a range of +/- X g. Valid
	  values are 2, 4, 8 and 16.

config MPU9250_GYRO_FS
	int "Gyroscope full-scale range"
	default 250
	help
	  Gyroscope full-scale range.
	  An X value for the config represents a range of +/- X degrees/second.
	  Valid values are 250, 500, 1000, 2000.

config MPU9250_GYRO_DLPF
	int "Gyroscope Digital Low Pass Filter setting"
	default 6
	range 0 7
	help
	  Gyroscope low pass filter setting according to the sensor documentation.

config MPU9250_GYRO_ODR
	int "Gyroscope Output Data Rate divider"
	default 99
	range 0 255
	help
	  Gyroscope output data rate divider. Rate = Sample_rate / (1 + ODR)

config MPU9250_MAGN_EN
	bool "Magnetometer enable"
	default true
	help
	  Choice to enable AK8963 magnetometer.

endif # MPU9250
```

## dts/bindings/sensor/invensense,mpu9250.yaml
```yaml
#
# Copyright (c) 2021 Nordic Semiconductor
#
# SPDX-License-Identifier: LicenseRef-Nordic-5-Clause
#

description: |
    InvenSense MPU-9250 Nine-Axis (Gyro + Accelerometer + Compass). See more
    info at https://www.invensense.com/products/motion-tracking/9-axis/mpu-9250/

compatible: "invensense,mpu9250"

include: i2c-device.yaml

properties:
    irq-gpios:
      type: phandle-array
      required: false
      description: |
        The INT signal default configuration is active-high.  The
        property value should ensure the flags properly describe the
        signal that is presented to the driver.
```
